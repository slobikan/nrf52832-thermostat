## esp32/Kconfig.projbuild
```kconfig
menu "AJAX KLIM"

config AJAX_WIFI_SSID
    string "Wi-Fi SSID"
    default ""

config AJAX_WIFI_PASSWORD
    string "Wi-Fi password"
    default ""

config AJAX_MQTT_URI
    string "MQTT broker URI"
    default "mqtt://192.168.1.10"

config AJAX_MQTT_USERNAME
    string "MQTT username"
    default ""

config AJAX_MQTT_PASSWORD
    string "MQTT password"
    default ""

config AJAX_HA_DISCOVERY_PREFIX
    string "Home Assistant discovery prefix"
    default "homeassistant"

config AJAX_DEVICE_NAME
    string "Device name"
    default "AJAX KLIM"

config AJAX_NODE_ID
    string "MQTT node id"
    default "ajax_klim_esp32"

config AJAX_ENABLE_UART
    bool "Enable UART link to RX module"
    default y

config AJAX_UART_BAUD
    int "UART baud rate"
    range 9600 921600
    default 115200

endmenu
```

## esp32/sdkconfig.defaults
```kconfig
CONFIG_ESPTOOLPY_FLASHMODE_DIO=y
CONFIG_ESP_CONSOLE_UART_DEFAULT=y
CONFIG_COMPILER_OPTIMIZATION_SIZE=y
CONFIG_ESP_MAIN_TASK_STACK_SIZE=8192
CONFIG_ETH_USE_SPI_ETHERNET=y
CONFIG_ETH_SPI_ETHERNET_W5500=y
# CONFIG_ETH_USE_ESP32_EMAC is not set
CONFIG_AJAX_WIFI_SSID="SLOBIKI"
CONFIG_AJAX_WIFI_PASSWORD="440123824"
CONFIG_AJAX_MQTT_URI="mqtt://192.168.0.249:1883"
CONFIG_AJAX_MQTT_USERNAME=""
CONFIG_AJAX_MQTT_PASSWORD=""
CONFIG_AJAX_HA_DISCOVERY_PREFIX="homeassistant"
CONFIG_AJAX_DEVICE_NAME="AJAX KLIM"
CONFIG_AJAX_NODE_ID="ajax_klim_esp32"
CONFIG_AJAX_ENABLE_UART=y
CONFIG_AJAX_UART_BAUD=115200
```
